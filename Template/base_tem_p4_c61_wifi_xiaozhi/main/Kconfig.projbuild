## Template/base_tem_p4_c61_wifi_xiaozhi/main/Kconfig.projbuild
```kconfig
menu "Application Configuration"

    orsource "$IDF_PATH/examples/idf_v555_my_exps/common/APL/apl_console/Kconfig.apl_console"

endmenu
```

## Template/base_template_p4/main/Kconfig.projbuild
```kconfig
menu "Application Configuration"

    orsource "$IDF_PATH/examples/idf_v551_my_exps/common/APL/apl_console/Kconfig.apl_console"
    orsource "$IDF_PATH/examples/idf_v551_my_exps/common/APL/apl_lvgl/Kconfig.apl_lvgl"

endmenu
```
